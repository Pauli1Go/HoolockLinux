## Documentation/devicetree/bindings/clock/apple,t8010-touch-clock.yaml
```yaml
# SPDX-License-Identifier: (GPL-2.0-only OR BSD-2-Clause)
%YAML 1.2
---
$id: http://devicetree.org/schemas/clock/apple,t8010-touch-clock.yaml#
$schema: http://devicetree.org/meta-schemas/core.yaml#

title: Apple T8010 touchscreen clock controller

maintainers:
  - Paul Praschl <praschlpaul@g-p.at>

description:
  The T8010 PMGR contains a gate and integer divider for the 24 MHz clock
  consumed by the touchscreen controller.

properties:
  compatible:
    const: apple,t8010-touch-clock

  reg:
    maxItems: 1

  clocks:
    maxItems: 1

  '#clock-cells':
    const: 0

  clock-output-names:
    maxItems: 1

  clock-frequency:
    description: Target clock rate in Hz

required:
  - compatible
  - reg
  - clocks
  - '#clock-cells'
  - clock-frequency

additionalProperties: false

examples:
  - |
    clock-controller@78000 {
        compatible = "apple,t8010-touch-clock";
        reg = <0x78000 0x8>;
        #clock-cells = <0>;
        clocks = <&clkref>;
        clock-output-names = "touchclk";
        clock-frequency = <24000000>;
    };
...
```

## Documentation/devicetree/bindings/dma/apple,sio.yaml
```yaml
# SPDX-License-Identifier: (GPL-2.0-only OR BSD-2-Clause)
%YAML 1.2
---
$id: http://devicetree.org/schemas/dma/apple,sio.yaml#
$schema: http://devicetree.org/meta-schemas/core.yaml#

title: Apple T8010 SmartIO coprocessor and DMA controller

description: |
  The T8010 SmartIO coprocessor provides DMA channels for peripheral
  controllers. The application processor boots the SmartIO firmware and
  submits DMA commands through the SIO message queues. Clients select the
  firmware endpoint number used by their peripheral.

maintainers:
  - Paul Praschl <praschlpaul@g-p.at>

allOf:
  - $ref: dma-controller.yaml#

properties:
  compatible:
    const: apple,t8010-sio

  reg:
    items:
      - description: AppleA7IOPV2 coprocessor and message queue registers
      - description: SmartIO DMA shim registers

  reg-names:
    items:
      - const: a7iop
      - const: shim

  interrupts:
    minItems: 4
    maxItems: 4
    description:
      The four interrupt outputs described by the T8010 SIO device tree node.

  power-domains:
    maxItems: 1

  firmware-name:
    maxItems: 1

  dma-channels:
    const: 64

  '#dma-cells':
    const: 1
    description:
      Clients specify the SmartIO DMA endpoint number, for example 0x1a for
      SPI3 transmit and 0x1b for SPI3 receive.

required:
  - compatible
  - reg
  - reg-names
  - interrupts
  - power-domains
  - firmware-name
  - dma-channels
  - '#dma-cells'

additionalProperties: false

examples:
  - |
    #include <dt-bindings/interrupt-controller/apple-aic.h>
    #include <dt-bindings/interrupt-controller/irq.h>

    soc {
      #address-cells = <2>;
      #size-cells = <2>;

      sio: dma-controller@20ae00000 {
        compatible = "apple,t8010-sio";
        reg = <0x2 0x0ae00000 0x0 0x10000>,
              <0x2 0x0a000000 0x0 0x2000>;
        reg-names = "a7iop", "shim";
        interrupts = <AIC_IRQ 211 IRQ_TYPE_LEVEL_HIGH>,
                     <AIC_IRQ 210 IRQ_TYPE_LEVEL_HIGH>,
                     <AIC_IRQ 213 IRQ_TYPE_LEVEL_HIGH>,
                     <AIC_IRQ 212 IRQ_TYPE_LEVEL_HIGH>;
        power-domains = <&ps_sio>;
        firmware-name = "apple/t8010-smartio.bin";
        dma-channels = <64>;
        #dma-cells = <1>;
      };
    };
```

## Documentation/devicetree/bindings/gpio/apple,d2365-pmic-gpio.yaml
```yaml
# SPDX-License-Identifier: (GPL-2.0-only OR BSD-2-Clause)
%YAML 1.2
---
$id: http://devicetree.org/schemas/gpio/apple,d2365-pmic-gpio.yaml#
$schema: http://devicetree.org/meta-schemas/core.yaml#

title: Apple T8010 PMIC GPIO controller

maintainers:
  - Paul Praschl <praschlpaul@g-p.at>

description: |
  The Dialog D2333 and D2365 PMICs used in Apple A10 devices provide 21 and
  24 GPIOs respectively. The controller is accessed through the regmap
  exported by the parent Apple I2C PMIC device.

properties:
  compatible:
    enum:
      - apple,d2333-pmic-gpio
      - apple,d2365-pmic-gpio

  gpio-controller: true

  "#gpio-cells":
    const: 2

  gpio-reserved-ranges:
    maxItems: 3

required:
  - compatible
  - gpio-controller
  - "#gpio-cells"

additionalProperties: false

examples:
  - |
    pmic {
        #address-cells = <1>;
        #size-cells = <1>;

        gpio {
            compatible = "apple,d2365-pmic-gpio";
            #gpio-cells = <2>;
            gpio-controller;
        };
    };
...
```

## Documentation/devicetree/bindings/iio/light/tsl2583.yaml
```yaml
# SPDX-License-Identifier: (GPL-2.0 OR BSD-2-Clause)
%YAML 1.2
---
$id: http://devicetree.org/schemas/iio/light/tsl2583.yaml#
$schema: http://devicetree.org/meta-schemas/core.yaml#

title: AMS/TAOS Ambient Light Sensor (ALS)

maintainers:
  - Brian Masney <masneyb@onstation.org>

description: |
  Ambient light sensing with an i2c interface. Apple CT821 factory
  calibration is stored in SysCfg. On systems where the SysCfg NVMEM
  provider is created by boot firmware, the static board tree omits the
  NVMEM link and firmware adds both NVMEM properties before kernel handoff.

properties:
  compatible:
    oneOf:
      - enum:
          - amstaos,tsl2580
          - amstaos,tsl2581
          - amstaos,tsl2583
      - items:
          - const: apple,ct821
          - const: amstaos,tsl2581

  reg:
    maxItems: 1

  interrupts:
    maxItems: 1

  vcc-supply:
    description: Regulator that provides power to the sensor

  nvmem-cells:
    description:
      Apple CT821 factory LSCI ambient-light calibration data. Boot firmware
      must populate this together with nvmem-cell-names when the provider is
      not statically representable.
    maxItems: 1

  nvmem-cell-names:
    items:
      - const: calibration

required:
  - compatible
  - reg

allOf:
  - if:
      properties:
        compatible:
          contains:
            const: apple,ct821
    then:
      dependentRequired:
        nvmem-cells:
          - nvmem-cell-names
        nvmem-cell-names:
          - nvmem-cells
    else:
      properties:
        nvmem-cells: false
        nvmem-cell-names: false

additionalProperties: false

examples:
  - |
    i2c {
        #address-cells = <1>;
        #size-cells = <0>;

        light-sensor@29 {
            compatible = "apple,ct821", "amstaos,tsl2581";
            reg = <0x29>;
            nvmem-cells = <&als_calibration>;
            nvmem-cell-names = "calibration";
        };
    };
...
```

## Documentation/devicetree/bindings/input/touchscreen/apple,z2-multitouch.yaml
```yaml
# SPDX-License-Identifier: (GPL-2.0 OR BSD-2-Clause)
%YAML 1.2
---
$id: http://devicetree.org/schemas/input/touchscreen/apple,z2-multitouch.yaml#
$schema: http://devicetree.org/meta-schemas/core.yaml#

title: Apple touchscreens attached using the Z2 protocol

maintainers:
  - Sasha Finkelstein <k@chaosmail.tech>
  - Paul Praschl <praschlpaul@g-p.at>

description: A series of touchscreen controllers used in Apple products

properties:
  compatible:
    enum:
      - apple,j293-touchbar
      - apple,j493-touchbar
      - apple,j172-touchscreen
      - apple,d11-touchscreen
      - apple,d111-touchscreen

  interrupts:
    maxItems: 1

  reset-gpios:
    maxItems: 1

  power-ana-gpios:
    maxItems: 1

  power-ldo-gpios:
    maxItems: 1

  hv-supply:
    description: High-voltage analog supply for the touchscreen controller

  core-supply:
    description: Core supply for the touchscreen controller

  display-sync-gpios:
    maxItems: 1

  display-sync1-gpios:
    maxItems: 1

  spi-cpha: true

  spi-cpol: true

  clocks:
    maxItems: 1

  apple,z2-bpw16-min-len:
    $ref: /schemas/types.yaml#/definitions/uint32
    description:
      Minimum firmware blob length sent using 16 bits per word.
    default: 1

  apple,z2-no-init-ack:
    description:
      Do not append the standard 0x1a 0xa1 ACK transfer after the initial
      firmware payload.
    type: boolean

  firmware-name:
    maxItems: 1

  apple,z2-cal-blob:
    $ref: /schemas/types.yaml#/definitions/uint8-array
    maxItems: 4096
    description:
      Calibration blob supplied by the bootloader

  apple,z2-orb-gap-cal-blob:
    $ref: /schemas/types.yaml#/definitions/uint8-array
    maxItems: 4096
    description:
      Orb gap calibration blob supplied by the bootloader

  apple,z2-orb-force-cal-blob:
    $ref: /schemas/types.yaml#/definitions/uint8-array
    maxItems: 4096
    description:
      Orb force calibration blob supplied by the bootloader

  apple,z2-shape-accel-cal-blob:
    $ref: /schemas/types.yaml#/definitions/uint8-array
    maxItems: 4096
    description:
      Dynamic shape acceleration calibration blob supplied by the bootloader

required:
  - compatible
  - interrupts
  - reset-gpios
  - firmware-name
  - touchscreen-size-x
  - touchscreen-size-y

allOf:
  - $ref: touchscreen.yaml#
  - $ref: /schemas/spi/spi-peripheral-props.yaml#
  - if:
      properties:
        compatible:
          const: apple,j172-touchscreen
    then:
      properties:
        pinctrl-names:
          const: display-sync-active
      required:
        - clocks
        - power-ana-gpios
        - power-ldo-gpios
        - display-sync-gpios
        - display-sync1-gpios
        - pinctrl-0
        - pinctrl-names
        - spi-cpha
        - spi-cpol
        - apple,z2-bpw16-min-len
        - apple,z2-no-init-ack
  - if:
      properties:
        compatible:
          enum:
            - apple,d11-touchscreen
            - apple,d111-touchscreen
    then:
      required:
        - clocks
        - hv-supply
        - core-supply
        - spi-cpha
        - spi-cpol
        - apple,z2-no-init-ack

unevaluatedProperties: false

examples:
  - |
    #include <dt-bindings/gpio/gpio.h>
    #include <dt-bindings/interrupt-controller/irq.h>

    spi {
        #address-cells = <1>;
        #size-cells = <0>;

        touchscreen@0 {
            compatible = "apple,j293-touchbar";
            reg = <0>;
            spi-max-frequency = <11500000>;
            reset-gpios = <&pinctrl_ap 139 GPIO_ACTIVE_LOW>;
            interrupts-extended = <&pinctrl_ap 194 IRQ_TYPE_EDGE_FALLING>;
            firmware-name = "apple/dfrmtfw-j293.bin";
            touchscreen-size-x = <23045>;
            touchscreen-size-y = <640>;
        };
    };

...
```

## Documentation/devicetree/bindings/mfd/apple,sn2400.yaml
```yaml
# SPDX-License-Identifier: GPL-2.0-only OR BSD-2-Clause
%YAML 1.2
---
$id: http://devicetree.org/schemas/mfd/apple,sn2400.yaml#
$schema: http://devicetree.org/meta-schemas/core.yaml#

title: Apple SN2400 battery charger

maintainers:
  - Paul Praschl <praschlpaul@g-p.at>

description:
  The SN2400, also known as Tigris, is an I2C battery charger used in Apple
  mobile devices. It also arbitrates access to the battery gauge HDQ line.

properties:
  compatible:
    const: apple,sn2400

  reg:
    maxItems: 1

  hdq-mux:
    type: object
    $ref: /schemas/mux/apple,sn2400-hdq-mux.yaml#
    unevaluatedProperties: false

  charger:
    type: object
    $ref: /schemas/power/supply/apple,sn2400-charger.yaml#
    unevaluatedProperties: false

required:
  - compatible
  - reg
  - hdq-mux

additionalProperties: false

examples:
  - |
    battery_info: battery {
        compatible = "simple-battery";
    };

    i2c {
        #address-cells = <1>;
        #size-cells = <0>;

        charger@75 {
            compatible = "apple,sn2400";
            reg = <0x75>;

            hdq_mux: hdq-mux {
                compatible = "apple,sn2400-hdq-mux";
                #mux-state-cells = <1>;
            };

            charger {
                compatible = "apple,sn2400-charger";
                monitored-battery = <&battery_info>;
                input-current-limit-microamp = <2000000>;
                mux-states = <&hdq_mux 0>;
                mux-state-names = "hdq";
            };
        };
    };
```

## Documentation/devicetree/bindings/mux/apple,sn2400-hdq-mux.yaml
```yaml
# SPDX-License-Identifier: GPL-2.0-only OR BSD-2-Clause
%YAML 1.2
---
$id: http://devicetree.org/schemas/mux/apple,sn2400-hdq-mux.yaml#
$schema: http://devicetree.org/meta-schemas/core.yaml#

title: Apple SN2400 HDQ multiplexer

maintainers:
  - Paul Praschl <praschlpaul@g-p.at>

description: |
  The SN2400 arbitrates access to the battery gauge HDQ line between its
  internal charging logic and the application processor. State 0 routes HDQ
  to the charger and state 1 routes it to the application processor.

allOf:
  - $ref: mux-controller.yaml#

properties:
  compatible:
    const: apple,sn2400-hdq-mux

  '#mux-state-cells':
    const: 1

required:
  - compatible
  - '#mux-state-cells'

additionalProperties: false
```

## Documentation/devicetree/bindings/nvmem/layouts/apple,syscfg.yaml
```yaml
# SPDX-License-Identifier: (GPL-2.0-only OR BSD-2-Clause)
%YAML 1.2
---
$id: http://devicetree.org/schemas/nvmem/layouts/apple,syscfg.yaml#
$schema: http://devicetree.org/meta-schemas/core.yaml#

title: Apple SysCfg NVMEM layout

maintainers:
  - Paul Praschl <praschlpaul@g-p.at>

description:
  Apple SysCfg stores board-specific key/value entries such as MAC addresses
  and wireless calibration blobs. This layout exposes selected four-character
  SysCfg keys as named NVMEM cells on top of an NVMEM provider containing a raw
  SysCfg blob.

properties:
  compatible:
    const: apple,syscfg

patternProperties:
  "^(?!compatible$)[a-zA-Z0-9][a-zA-Z0-9,._+-]*$":
    type: object
    additionalProperties: false

    properties:
      apple,syscfg-key:
        description: Four-character SysCfg key to expose as this cell.
        $ref: /schemas/types.yaml#/definitions/string
        pattern: '^[A-Za-z0-9]{4}$'

      apple,syscfg-size:
        description:
          Optional number of bytes to expose from the start of the SysCfg
          value. If omitted, the full inline value or jumbo value is exposed.
        $ref: /schemas/types.yaml#/definitions/uint32
        minimum: 1

    required:
      - apple,syscfg-key

required:
  - compatible

additionalProperties: false

examples:
  - |
    reserved-memory {
        #address-cells = <2>;
        #size-cells = <2>;

        syscfg@90000000 {
            compatible = "apple,syscfg-rmem", "nvmem-rmem";
            reg = <0x0 0x90000000 0x0 0x20000>;
            no-map;

            nvmem-layout {
                compatible = "apple,syscfg";

                calibration {
                    apple,syscfg-key = "WCAL";
                };

                mac-address {
                    apple,syscfg-key = "WMac";
                    apple,syscfg-size = <6>;
                };
            };
        };
    };
```
