## Documentation/devicetree/bindings/power/supply/apple,sn2400-charger.yaml
```yaml
# SPDX-License-Identifier: GPL-2.0-only OR BSD-2-Clause
%YAML 1.2
---
$id: http://devicetree.org/schemas/power/supply/apple,sn2400-charger.yaml#
$schema: http://devicetree.org/meta-schemas/core.yaml#

title: Apple SN2400 USB charger

maintainers:
  - Paul Praschl <praschlpaul@g-p.at>

description:
  The SN2400, also known as Tigris, is a single-cell battery charger used in
  Apple mobile devices. The charger measures VBUS and input current and uses
  those measurements to select a safe USB input-current limit.

allOf:
  - $ref: power-supply.yaml#
  - $ref: /schemas/mux/mux-consumer.yaml#

properties:
  compatible:
    const: apple,sn2400-charger

  monitored-battery: true

  input-current-limit-microamp:
    minimum: 300000
    maximum: 2000000
    multipleOf: 10000
    description:
      Maximum USB input current that the foldback policy may request.

  mux-states:
    maxItems: 1

  mux-state-names:
    items:
      - const: hdq

required:
  - compatible
  - monitored-battery
  - input-current-limit-microamp
  - mux-states
  - mux-state-names

unevaluatedProperties: false
```

## Documentation/devicetree/bindings/power/supply/ti,bq27545-hdq-uart.yaml
```yaml
# SPDX-License-Identifier: GPL-2.0-only OR BSD-2-Clause
%YAML 1.2
---
$id: http://devicetree.org/schemas/power/supply/ti,bq27545-hdq-uart.yaml#
$schema: http://devicetree.org/meta-schemas/core.yaml#

title: Texas Instruments BQ27545 fuel gauge using HDQ over UART

maintainers:
  - Paul Praschl <praschlpaul@g-p.at>

description: |
  The BQ27545 single-wire HDQ bus can be driven by a UART using one serial
  byte for each HDQ bit. The UART is configured for 57600 baud, 8 data bits,
  no parity, and 2 stop bits. A serial BREAK generates the HDQ break pulse.
  This connection is used by Apple T8010 devices.

allOf:
  - $ref: power-supply.yaml#
  - $ref: /schemas/serial/serial-peripheral-props.yaml#

properties:
  compatible:
    const: ti,bq27545-hdq-uart

  power-supplies:
    maxItems: 1

  monitored-battery: true

required:
  - compatible
  - power-supplies

additionalProperties: false

examples:
  - |
    charger: charger {
    };

    serial {
        fuel-gauge {
            compatible = "ti,bq27545-hdq-uart";
            power-supplies = <&charger>;
            monitored-battery = <&battery_info>;
        };
    };
```

## Documentation/devicetree/bindings/power/supply/ti,bq27545-hdq.yaml
```yaml
# SPDX-License-Identifier: GPL-2.0-only OR BSD-2-Clause
%YAML 1.2
---
$id: http://devicetree.org/schemas/power/supply/ti,bq27545-hdq.yaml#
$schema: http://devicetree.org/meta-schemas/core.yaml#

title: Texas Instruments BQ27545 fuel gauge on an HDQ bus

maintainers:
  - Paul Praschl <praschlpaul@g-p.at>

description: |
  The BQ27545 is a single-cell fuel gauge which can communicate using the
  Texas Instruments single-wire HDQ protocol. An HDQ device has no 1-Wire
  ROM address, so it is represented as the single child of an HDQ bus.
  D11 and D111 devices use Apple-specific gauge firmware whose
  charge-remaining register set differs from the generic BQ27545 profile.

allOf:
  - $ref: power-supply.yaml#

properties:
  compatible:
    oneOf:
      - const: ti,bq27545-hdq
      - items:
          - enum:
              - apple,d11-bq27545
              - apple,d111-bq27545
          - const: ti,bq27545-hdq

  power-supplies:
    maxItems: 1

  monitored-battery: true

required:
  - compatible

additionalProperties: false

examples:
  - |
    battery_info: battery {
        compatible = "simple-battery";
    };

    serial {
        onewire {
            compatible = "ti,hdq-uart";

            fuel-gauge {
                compatible = "ti,bq27545-hdq";
                monitored-battery = <&battery_info>;
            };
        };
    };
```

## Documentation/devicetree/bindings/regulator/apple,pmic-touch-regulator.yaml
```yaml
# SPDX-License-Identifier: (GPL-2.0-only OR BSD-2-Clause)
%YAML 1.2
---
$id: http://devicetree.org/schemas/regulator/apple,pmic-touch-regulator.yaml#
$schema: http://devicetree.org/meta-schemas/core.yaml#

title: Apple PMIC touchscreen supply regulators

maintainers:
  - Paul Praschl <praschlpaul@g-p.at>

description:
  Fixed touchscreen supply switches provided by the Adelyn and Chestnut
  PMICs. The compatible identifies both the PMIC and the physical supply;
  register layout is an implementation detail of the regulator driver.

allOf:
  - $ref: regulator.yaml#

properties:
  compatible:
    enum:
      - apple,adelyn-touch-core-regulator
      - apple,chestnut-touch-hv-regulator

required:
  - compatible

unevaluatedProperties: false

examples:
  - |
    regulator-touch-core {
        compatible = "apple,adelyn-touch-core-regulator";
        regulator-name = "touch-core";
    };

...
```

## Documentation/devicetree/bindings/soc/apple/apple,t8010-wlan-uart-provider.yaml
```yaml
# SPDX-License-Identifier: (GPL-2.0-only OR BSD-2-Clause)
%YAML 1.2
---
$id: http://devicetree.org/schemas/soc/apple/apple,t8010-wlan-uart-provider.yaml#
$schema: http://devicetree.org/meta-schemas/core.yaml#

title: Apple T8010 WLAN UART platform control

maintainers:
  - Paul Praschl <praschlpaul@g-p.at>

description:
  Apple T8010 devices use a UART-compatible register block as part of the
  platform-control path for the PCIe WLAN module. The provider selects the
  WLAN pins, keeps the associated power domain active, and initializes the
  register block before the PCI endpoint is powered.

properties:
  compatible:
    const: apple,t8010-wlan-uart-provider

  reg:
    maxItems: 1

  pinctrl-0: true

  pinctrl-names:
    const: default

  power-domains:
    maxItems: 1

required:
  - compatible
  - reg
  - pinctrl-0
  - pinctrl-names
  - power-domains

additionalProperties: false

examples:
  - |
    / {
        #address-cells = <2>;
        #size-cells = <2>;

        wlan-platform-control@20a0c8000 {
            compatible = "apple,t8010-wlan-uart-provider";
            reg = <0x2 0x0a0c8000 0x0 0x4000>;
            pinctrl-0 = <&wlan_uart2_pins>;
            pinctrl-names = "default";
            power-domains = <&ps_uart2>;
        };
    };
...
```

## Documentation/devicetree/bindings/spi/apple,spi.yaml
```yaml
# SPDX-License-Identifier: (GPL-2.0-only OR BSD-2-Clause)
%YAML 1.2
---
$id: http://devicetree.org/schemas/spi/apple,spi.yaml#
$schema: http://devicetree.org/meta-schemas/core.yaml#

title: Apple ARM SoC SPI controller

allOf:
  - $ref: spi-controller.yaml#

maintainers:
  - Hector Martin <marcan@marcan.st>
  - Paul Praschl <praschlpaul@g-p.at>

properties:
  compatible:
    oneOf:
      - items:
          - const: apple,t6020-spi
          - const: apple,t8103-spi
      - items:
          - enum:
              - apple,t8010-spi
              - apple,t8103-spi
              - apple,t8112-spi
              - apple,t6000-spi
          - const: apple,spi

  reg:
    maxItems: 1

  clocks:
    maxItems: 1

  interrupts:
    maxItems: 1

  power-domains:
    maxItems: 1

  dmas:
    maxItems: 1

  dma-names:
    const: tx

  apple,t8010-word-delay:
    $ref: /schemas/types.yaml#/definitions/uint32
    description:
      Legacy T8010 inter-word delay register value.

required:
  - compatible
  - reg
  - clocks
  - interrupts

dependentRequired:
  dmas:
    - dma-names

unevaluatedProperties: false

examples:
  - |
    #include <dt-bindings/interrupt-controller/apple-aic.h>
    #include <dt-bindings/interrupt-controller/irq.h>

    soc {
      #address-cells = <2>;
      #size-cells = <2>;

      spi@39b104000 {
        compatible = "apple,t6000-spi", "apple,spi";
        reg = <0x3 0x9b104000 0x0 0x4000>;
        interrupt-parent = <&aic>;
        interrupts = <AIC_IRQ 0 1107 IRQ_TYPE_LEVEL_HIGH>;
        #address-cells = <1>;
        #size-cells = <0>;
        clocks = <&clk>;
      };
    };
```

## drivers/soc/apple/Kconfig
```kconfig
# SPDX-License-Identifier: GPL-2.0-only

if ARCH_APPLE || COMPILE_TEST

menu "Apple SoC drivers"

config APPLE_MAILBOX
	tristate "Apple SoC mailboxes"
	depends on PM
	depends on ARCH_APPLE || (64BIT && COMPILE_TEST)
	help
	  Apple SoCs have various co-processors required for certain
	  peripherals to work (NVMe, display controller, etc.). This
	  driver adds support for the mailbox controller used to
	  communicate with those.

	  Say Y here if you have an Apple SoC.

config APPLE_RTKIT
	tristate "Apple RTKit co-processor IPC protocol"
	depends on APPLE_MAILBOX
	depends on ARCH_APPLE || COMPILE_TEST
	help
	  Apple SoCs such as the M1 come with various co-processors running
	  their proprietary RTKit operating system. This option enables support
	  for the protocol library used to communicate with those. It is used
	  by various client drivers.

	  Say 'y' here if you have an Apple SoC.

config APPLE_PMP_T8015_V1
	tristate "Apple T8015 PMP"
	depends on ARCH_APPLE || COMPILE_TEST
	help
	  Apple PMP is a coprocessor with power-management functions. This
	  option enable support for booting its firmware, which is enough
	  to reduce power consumption.

	  Say 'y' here if you have an Apple A11 SoC.

config APPLE_SIO
	tristate "Apple T8010 SmartIO coprocessor"
	depends on ARM64
	depends on PM
	depends on ARCH_APPLE || COMPILE_TEST
	help
	  Support the SmartIO coprocessor found on Apple T8010 SoCs. SmartIO
	  boots dedicated firmware and exchanges endpoint messages with the
	  application processor. It provides DMA services to peripheral
	  controllers such as SPI.

	  Say Y here if you have an Apple T8010 SoC.

config APPLE_T8010_WLAN
	tristate "Apple T8010 WLAN platform control"
	depends on PM
	depends on ARCH_APPLE || COMPILE_TEST
	help
	  Support the UART-compatible platform-control block associated with
	  PCIe WLAN modules on Apple T8010 devices. The driver initializes the
	  block and provides the runtime-PM supplier used by the PCI power
	  control driver.

	  Say Y here if you have an Apple T8010 device with PCIe Wi-Fi.

config APPLE_SART
	tristate "Apple SART DMA address filter"
	depends on ARCH_APPLE || COMPILE_TEST
	help
	  Apple SART is a simple DMA address filter used on Apple SoCs such
	  as the M1. It is usually required for the NVMe coprocessor which does
	  not use a proper IOMMU.

	  Say 'y' here if you have an Apple SoC.

config APPLE_TUNABLE
	tristate
	depends on ARCH_APPLE || COMPILE_TEST

endmenu

endif
```
