## Documentation/devicetree/bindings/pci/apple,t8010-pcie.yaml
```yaml
# SPDX-License-Identifier: (GPL-2.0-only OR BSD-2-Clause)
%YAML 1.2
---
$id: http://devicetree.org/schemas/pci/apple,t8010-pcie.yaml#
$schema: http://devicetree.org/meta-schemas/core.yaml#

title: Apple T8010 PCIe host controller

maintainers:
  - Paul Praschl <praschlpaul@g-p.at>

description: |
  Apple A10/T8010 devices use the H9P PCIe root complex for internal
  storage and Wi-Fi. It exposes one ECAM window shared by up to four root
  ports, controller-specific PHY and port register windows, and a local MSI
  block.

  The storage port also contains an NVMMU which translates the proprietary
  Apple ANS FlatDMA format. Unlike a general-purpose IOMMU, this block uses a
  loader-provided, physically contiguous host-memory buffer and a fixed IOVA
  window. The PCIe driver owns that NVMMU state and exposes it only to the ANS
  NVMe glue.

  Each enabled root port is represented by a child node. This allows port
  devices to carry their own reset, clock-request, firmware and other
  device-specific properties.

allOf:
  - $ref: /schemas/pci/pci-host-bridge.yaml#
  - $ref: /schemas/interrupt-controller/msi-controller.yaml#

properties:
  compatible:
    oneOf:
      - const: apple,t8010-pcie
      - items:
          - const: apple,j172-pcie
          - const: apple,t8010-pcie

  reg:
    maxItems: 9

  reg-names:
    items:
      - const: config
      - const: rc
      - const: phy
      - const: phy-ip
      - const: port0
      - const: port1
      - const: port2
      - const: port3
      - const: nvmmu

  interrupts:
    description:
      One state interrupt for each root port followed by the storage-port
      NVMMU fault interrupt.
    maxItems: 5

  interrupt-names:
    items:
      - const: port0
      - const: port1
      - const: port2
      - const: port3
      - const: nvmmu

  clocks:
    minItems: 2
    maxItems: 2

  clock-names:
    items:
      - const: aux
      - const: ref

  power-domains:
    maxItems: 1

  msi-parent: true

  msi-ranges:
    maxItems: 1

  apple,msi-doorbell:
    $ref: /schemas/types.yaml#/definitions/uint32
    description:
      MSI doorbell address programmed into downstream endpoints.

  apple,nvmmu-iova:
    $ref: /schemas/types.yaml#/definitions/uint32
    description:
      Base device-visible address of the storage-port NVMMU window.

  apple,nvme-hmb:
    $ref: /schemas/types.yaml#/definitions/phandle
    description:
      Phandle of the loader-populated reserved-memory node used as the Apple
      ANS NVMe host-memory buffer.

  apple,preinit-phy-port-mask:
    $ref: /schemas/types.yaml#/definitions/uint32
    maximum: 15
    description:
      Bit mask of internal root ports whose RC and PHY lane must be initialized
      without exposing a root bridge. This is used when an enabled port shares
      PHY state with a firmware-enabled sibling port.

  interrupt-controller: true

  '#interrupt-cells':
    const: 1

patternProperties:
  '^pci@[0-3],0$':
    type: object
    properties:
      reg:
        maxItems: 1

      reset-gpios:
        maxItems: 1

      clkreq-gpios:
        maxItems: 1
        description:
          Software-observable CLKREQ# input. This is optional when the pad is
          pinmuxed directly to the PCIe controller instead.

      max-link-speed:
        enum: [1, 2, 3]
        description:
          Maximum link generation exposed by this root port. This also limits
          the controller's Link Capabilities registers when runtime speed
          retraining is not implemented for the port.

      apple,phy-lane:
        $ref: /schemas/types.yaml#/definitions/uint32
        maximum: 3
        description:
          PHY IP calibration lane used by this root port. If omitted, the
          root-port number is used.

      apple,manual-availability-iommu:
        $ref: /schemas/types.yaml#/definitions/phandle-array
        maxItems: 1
        description:
          DART and stream whose retained configuration must be reloaded while
          this root port is brought up. This models Apple's manual-availability
          lifecycle before the endpoint is released from reset.

      apple,link-retry-after-power-cycle:
        type: boolean
        description:
          Retry this root port once after cycling endpoint power when the first
          complete port-enable lifecycle does not make the link usable.

      apple,hardware-trained-phy-lane:
        type: boolean
        description:
          The PHY lane enters its calibrated operating state as part of
          enabling the root port. Static lane initialization values must not be
          applied after the port-enable sequence because that would overwrite
          the hardware-trained state.

      apple,endpoint-power-after-link-setup:
        type: boolean
        description:
          Keep the endpoint power control disabled through the initial root-port
          setup, then complete link-event configuration before enabling it.
          The controller observes link state only after the endpoint power
          control has completed its stabilization interval and before the
          endpoint is released from reset.

      apple,inherited-perst-before-link-setup:
        type: boolean
        description:
          Preserve PERST# as an input during the first root-port setup instead
          of actively asserting it. A single power-cycle retry uses the normal
          asserted output state.

    required:
      - reg
      - reset-gpios

    additionalProperties: true

required:
  - compatible
  - reg
  - reg-names
  - interrupts
  - interrupt-names
  - clocks
  - clock-names
  - power-domains
  - bus-range
  - ranges
  - msi-controller
  - msi-parent
  - msi-ranges
  - apple,nvmmu-iova
  - apple,nvme-hmb
  - '#interrupt-cells'

unevaluatedProperties: false

examples:
  - |
    #include <dt-bindings/gpio/gpio.h>
    #include <dt-bindings/interrupt-controller/apple-aic.h>

    / {
        #address-cells = <2>;
        #size-cells = <2>;

        aliases {
            nvme-hmb = &nvme_hmb;
        };

        aic: interrupt-controller {
            interrupt-controller;
            #interrupt-cells = <3>;
        };

        reserved-memory {
            #address-cells = <2>;
            #size-cells = <2>;
            ranges;

            nvme_hmb: nvme-hmb@0 {
                reg = <0x0 0x0 0x0 0x0>; /* To be filled by loader */
                no-map;
            };
        };

        soc {
            #address-cells = <2>;
            #size-cells = <2>;

            pcie0: pcie@610000000 {
                compatible = "apple,t8010-pcie";
                device_type = "pci";

                reg = <0x6 0x10000000 0x0 0x1000000>,
                      <0x6 0x00000000 0x0 0x8000>,
                      <0x6 0x00008000 0x0 0x4000>,
                      <0x6 0x0a000000 0x0 0x40000>,
                      <0x6 0x01000000 0x0 0x4000>,
                      <0x6 0x02000000 0x0 0x4000>,
                      <0x6 0x03000000 0x0 0x4000>,
                      <0x6 0x04000000 0x0 0x4000>,
                      <0x6 0x01004000 0x0 0x4000>;
                reg-names = "config", "rc", "phy", "phy-ip",
                            "port0", "port1", "port2", "port3",
                            "nvmmu";

                interrupt-parent = <&aic>;
                interrupts = <AIC_IRQ 270 IRQ_TYPE_LEVEL_HIGH>,
                             <AIC_IRQ 273 IRQ_TYPE_LEVEL_HIGH>,
                             <AIC_IRQ 276 IRQ_TYPE_LEVEL_HIGH>,
                             <AIC_IRQ 279 IRQ_TYPE_LEVEL_HIGH>,
                             <AIC_IRQ 272 IRQ_TYPE_EDGE_RISING>;
                interrupt-names = "port0", "port1", "port2", "port3",
                                  "nvmmu";

                msi-controller;
                msi-parent = <&pcie0>;
                msi-ranges = <&aic AIC_IRQ 288 IRQ_TYPE_EDGE_RISING 32>;
                apple,msi-doorbell = <0xbffff000>;
                apple,nvmmu-iova = <0xbc000000>;
                apple,nvme-hmb = <&nvme_hmb>;

                #address-cells = <3>;
                #size-cells = <2>;
                #interrupt-cells = <1>;
                interrupt-controller;
                bus-range = <0x00 0x0f>;
                ranges = <0x03000000 0x0 0xc0000000
                          0x7 0xc0000000 0x0 0x40000000>;

                clocks = <&clkref>, <&clkref>;
                clock-names = "aux", "ref";
                power-domains = <&ps_pcie>;

                pci@0,0 {
                    device_type = "pci";
                    reg = <0x0 0x0 0x0 0x0 0x0>;
                    reset-gpios = <&pinctrl_ap 12 GPIO_ACTIVE_LOW>;
                    clkreq-gpios = <&pinctrl_ap 16 GPIO_ACTIVE_LOW>;

                    #address-cells = <3>;
                    #size-cells = <2>;
                    ranges;
                };
            };
        };
    };

...
```

## Documentation/devicetree/bindings/power/apple,pmgr-pwrstate.yaml
```yaml
# SPDX-License-Identifier: (GPL-2.0-only OR BSD-2-Clause)
%YAML 1.2
---
$id: http://devicetree.org/schemas/power/apple,pmgr-pwrstate.yaml#
$schema: http://devicetree.org/meta-schemas/core.yaml#

title: Apple SoC PMGR Power States

maintainers:
  - Hector Martin <marcan@marcan.st>

description: |
  Apple SoCs include PMGR blocks responsible for power management,
  which can control various clocks, resets, power states, and
  performance features. This binding describes the device power
  state registers, which control power states and resets.

  Most instances within the PMGR syscon node represent a generic power
  domain provider, as documented in
  Documentation/devicetree/bindings/power/power-domain.yaml. A state
  register may instead be exposed exclusively as a clock gate when the
  hardware consumer has no power-domain or reset interface. Each provider
  controls a single SoC block. The power hierarchy is represented via
  power-domains relationships between generic power-domain nodes.

  See Documentation/devicetree/bindings/arm/apple/apple,pmgr.yaml
  for the top-level PMGR node documentation.

properties:
  compatible:
    oneOf:
      - items:
          - enum:
              # Do not add additional SoC to this list.
              - apple,s5l8960x-pmgr-pwrstate
              - apple,t7000-pmgr-pwrstate
              - apple,s8000-pmgr-pwrstate
              - apple,t8010-pmgr-pwrstate
              - apple,t8015-pmgr-pwrstate
              - apple,t8103-pmgr-pwrstate
              - apple,t8112-pmgr-pwrstate
              - apple,t6000-pmgr-pwrstate
          - const: apple,pmgr-pwrstate
      - items:
          - enum:
              - apple,t6020-pmgr-pwrstate
              - apple,t8122-pmgr-pwrstate
          - const: apple,t8103-pmgr-pwrstate

  reg:
    maxItems: 1

  "#power-domain-cells":
    const: 0

  "#clock-cells":
    const: 0
    description:
      Exposes this PMGR state register as a clock gate. Enabling the clock
      preserves an already active firmware state or requests the active state;
      disabling it retains power while requesting the clock-gated state. A
      state register exposed as a generic power domain cannot also be exposed
      as a clock provider.

  "#reset-cells":
    const: 0

  power-domains:
    description:
      Reference to parent power domains. A domain may have multiple parents,
      and all will be powered up when it is powered.
    minItems: 1
    maxItems: 8 # Arbitrary, should be enough

  label:
    description:
      Specifies the name of the SoC domain being controlled. This is used to
      name the power/reset domains.

  apple,always-on:
    description:
      Forces this power domain to always be powered up.
    type: boolean

  apple,clock-gate-only:
    description:
      Registers this PMGR state exclusively as a clock gate. This is used
      when the hardware provider exposes no generic power-domain or reset
      interface for the state register.
    type: boolean

  apple,manual-pm:
    description:
      Keeps firmware-enabled hardware under explicit clock and power control
      instead of enabling PMGR auto-PM while the provider is registered.
    type: boolean

  apple,min-state:
    description:
      Specifies the minimum power state for auto-PM.
      0 = power gated, 4 = clock gated, 15 = on.
    $ref: /schemas/types.yaml#/definitions/uint32
    minimum: 0
    maximum: 15

required:
  - compatible
  - reg
  - label

allOf:
  - if:
      required:
        - apple,clock-gate-only
    then:
      required:
        - "#clock-cells"
      not:
        anyOf:
          - required:
              - "#power-domain-cells"
          - required:
              - "#reset-cells"
          - required:
              - power-domains
          - required:
              - apple,always-on
          - required:
              - apple,min-state
    else:
      allOf:
        - $ref: power-domain.yaml#
      required:
        - "#power-domain-cells"
        - "#reset-cells"

additionalProperties: false
```

## Documentation/devicetree/bindings/power/supply/apple,bellatrix.yaml
```yaml
# SPDX-License-Identifier: GPL-2.0-only OR BSD-2-Clause
%YAML 1.2
---
$id: http://devicetree.org/schemas/power/supply/apple,bellatrix.yaml#
$schema: http://devicetree.org/meta-schemas/core.yaml#

title: Apple Bellatrix USB power controller

maintainers:
  - Paul Praschl <praschlpaul@g-p.at>

description: |
  Bellatrix is an I2C power and accessory controller used in some Apple
  T8010 devices. The Linux driver reports cached USB input presence without
  changing charging, ADC, power-role, or interrupt configuration.

allOf:
  - $ref: power-supply.yaml#

properties:
  compatible:
    const: apple,bellatrix

  reg:
    maxItems: 1

  interrupts:
    maxItems: 1

required:
  - compatible
  - reg

additionalProperties: false

examples:
  - |
    #include <dt-bindings/interrupt-controller/irq.h>

    i2c {
        #address-cells = <1>;
        #size-cells = <0>;

        usb-power@13 {
            compatible = "apple,bellatrix";
            reg = <0x13>;
            interrupts = <13 IRQ_TYPE_LEVEL_LOW>;
        };
    };
```

## Documentation/devicetree/bindings/power/supply/apple,d2365-charger.yaml
```yaml
# SPDX-License-Identifier: GPL-2.0-only OR BSD-2-Clause
%YAML 1.2
---
$id: http://devicetree.org/schemas/power/supply/apple,d2365-charger.yaml#
$schema: http://devicetree.org/meta-schemas/core.yaml#

title: Apple D2365 PMIC charger

maintainers:
  - Paul Praschl <praschlpaul@g-p.at>

description: |
  The Apple D2365 PMIC contains power-source status and charger-control banks.
  The J172 variant uses a platform-calibrated, guarded input-current policy.

allOf:
  - $ref: power-supply.yaml#

properties:
  compatible:
    oneOf:
      - const: apple,d2365-charger
      - items:
          - const: apple,j172-d2365-charger
          - const: apple,d2365-charger

  reg:
    minItems: 2
    maxItems: 2
    items:
      - description: Charger status register bank.
      - description: Charger control register bank.

  reg-names:
    items:
      - const: status
      - const: control

  power-supplies:
    maxItems: 1

required:
  - compatible
  - reg
  - reg-names
  - power-supplies

additionalProperties: false

examples:
  - |
    i2c {
        #address-cells = <1>;
        #size-cells = <0>;

        usb_power: usb-power@13 {
            compatible = "apple,bellatrix";
            reg = <0x13>;
        };
    };

    pmic {
        #address-cells = <1>;
        #size-cells = <1>;

        charger@180 {
            compatible = "apple,d2365-charger";
            reg = <0x180 0x1e>, <0xa00 0x0d>;
            reg-names = "status", "control";
            power-supplies = <&usb_power>;
        };
    };
```
